VERSION ""

NS_ :

BS_:

BU_: hytech

BO_ 213 ID_BMS_ONBOARD_TEMPERATURES: 6 Vector__XXX
 SG_ high temp : 32|16@1- (0.01,0) [0|0] "" Vector__XXX
 SG_ low temp : 16|16@1- (0.01,0) [0|0] "" Vector__XXX
 SG_ average temp : 0|16@1- (0.01,0) [0|0] "" Vector__XXX

BO_ 214 ID_BMS_ONBOARD_DETAILED_TEMPERAT: 5 Vector__XXX
 SG_ temp 1 : 24|16@1- (0.01,0) [0|0] "" Vector__XXX
 SG_ temp 0 : 8|16@1- (0.01,0) [0|0] "" Vector__XXX
 SG_ ic id : 0|8@1+ (1,0) [0|0] "" Vector__XXX

BO_ 215 ID_BMS_VOLTAGES: 8 Vector__XXX
 SG_ total voltage : 48|16@1+ (0.01,0) [0|0] "" Vector__XXX
 SG_ high voltage : 32|16@1+ (0.0001,0) [0|0] "" Vector__XXX
 SG_ low voltage : 16|16@1+ (0.0001,0) [0|0] "" Vector__XXX
 SG_ average voltage : 0|16@1+ (0.0001,0) [0|0] "" Vector__XXX

BO_ 216 ID_BMS_DETAILED_VOLTAGES: 7 Vector__XXX
 SG_ voltage 2 : 40|16@1+ (0.0001,0) [0|0] "" Vector__XXX
 SG_ voltage 1 : 24|16@1+ (0.0001,0) [0|0] "" Vector__XXX
 SG_ voltage 0 : 8|16@1+ (0.0001,0) [0|0] "" Vector__XXX
 SG_ ic id : 4|4@1+ (1,0) [0|0] "" Vector__XXX
 SG_ group id : 0|4@1+ (1,0) [0|0] "" Vector__XXX

BO_ 217 ID_BMS_TEMPERATURES: 6 Vector__XXX
 SG_ high temp : 32|16@1- (0.01,0) [0|0] "" Vector__XXX
 SG_ low temp : 16|16@1- (0.01,0) [0|0] "" Vector__XXX
 SG_ average temp : 0|16@1- (0.01,0) [0|0] "" Vector__XXX

BO_ 218 ID_BMS_DETAILED_TEMPERATURES: 7 Vector__XXX
 SG_ thermistor id 2 : 40|16@1- (0.01,0) [0|0] "" Vector__XXX
 SG_ thermistor id 1 : 24|16@1- (0.01,0) [0|0] "" Vector__XXX
 SG_ thermistor id 0 : 8|16@1- (0.01,0) [0|0] "" Vector__XXX
 SG_ group id : 4|4@1+ (1,0) [0|0] "" Vector__XXX
 SG_ ic id : 0|4@1+ (1,0) [0|0] "" Vector__XXX

BO_ 219 ID_BMS_STATUS: 6 Vector__XXX
 SG_ shutdown h above threshold error : 41|1@1+ (1,0) [0|0] "" Vector__XXX
 SG_ shutdown g above threshold error : 40|1@1+ (1,0) [0|0] "" Vector__XXX
 SG_ current : 24|16@1- (0.01,0) [0|0] "" Vector__XXX
 SG_ overtemp error : 16|1@1+ (1,0) [0|0] "" Vector__XXX
 SG_ undertemp error : 15|1@1+ (1,0) [0|0] "" Vector__XXX
 SG_ charge overtemp error : 14|1@1+ (1,0) [0|0] "" Vector__XXX
 SG_ discharge overtemp error : 13|1@1+ (1,0) [0|0] "" Vector__XXX
 SG_ charge overcurrent error : 12|1@1+ (1,0) [0|0] "" Vector__XXX
 SG_ discharge overcurrent error : 11|1@1+ (1,0) [0|0] "" Vector__XXX
 SG_ total voltage high error : 10|1@1+ (1,0) [0|0] "" Vector__XXX
 SG_ undervoltage error : 9|1@1+ (1,0) [0|0] "" Vector__XXX
 SG_ overvoltage error : 8|1@1+ (1,0) [0|0] "" Vector__XXX
 SG_ state : 0|8@1+ (1,0) [0|0] "" Vector__XXX

BO_ 221 ID_CCU_STATUS: 1 Vector__XXX
 SG_ charger enabled : 0|1@1+ (1,0) [0|0] "" Vector__XXX

BO_ 226 ID_BMS_COULOMB_COUNTS: 8 Vector__XXX
 SG_ total discharge : 32|32@1+ (0.0001,0) [0|0] "Coulombs" Vector__XXX
 SG_ total charge : 0|32@1+ (0.0001,0) [0|0] "" Vector__XXX

BO_ 235 ID_DASHBOARD_STATUS: 7 Vector__XXX
 SG_ launch control led : 48|2@1+ (1,0) [0|0] "" Vector__XXX
 SG_ glv led : 46|2@1+ (1,0) [0|0] "" Vector__XXX
 SG_ crit charge led : 44|2@1+ (1,0) [0|0] "" Vector__XXX
 SG_ cockpit brb led : 42|2@1+ (1,0) [0|0] "" Vector__XXX
 SG_ bots led : 40|2@1+ (1,0) [0|0] "" Vector__XXX
 SG_ gen purp led : 38|2@1+ (1,0) [0|0] "" Vector__XXX
 SG_ mechanical brake led : 36|2@1+ (1,0) [0|0] "" Vector__XXX
 SG_ inertia status led : 34|2@1+ (1,0) [0|0] "" Vector__XXX
 SG_ start status led : 32|2@1+ (1,0) [0|0] "" Vector__XXX
 SG_ motor controller error led : 30|2@1+ (1,0) [0|0] "" Vector__XXX
 SG_ mode led : 28|2@1+ (1,0) [0|0] "" Vector__XXX
 SG_ imd led : 26|2@1+ (1,0) [0|0] "" Vector__XXX
 SG_ ams led : 24|2@1+ (1,0) [0|0] "" Vector__XXX
 SG_ dial state : 16|8@1+ (1,0) [0|0] "" Vector__XXX
 SG_ led dimmer button : 13|1@1+ (1,0) [0|0] "" Vector__XXX
 SG_ torque mode button : 12|1@1+ (1,0) [0|0] "" Vector__XXX
 SG_ launch ctrl button  : 11|1@1+ (1,0) [0|0] "" Vector__XXX
 SG_ motor controller cycle button : 10|1@1+ (1,0) [0|0] "" Vector__XXX
 SG_ mode button : 9|1@1+ (1,0) [0|0] "" Vector__XXX
 SG_ mark button : 8|1@1+ (1,0) [0|0] "" Vector__XXX
 SG_ shutdown h above threshold : 3|1@1+ (1,0) [0|0] "" Vector__XXX
 SG_ ssok above threshold : 2|1@1+ (1,0) [0|0] "" Vector__XXX
 SG_ buzzer active : 1|1@1+ (1,0) [0|0] "" Vector__XXX
 SG_ start button : 0|1@1+ (1,0) [0|0] "" Vector__XXX

BO_ 2550588916 ID_CHARGER_CONTROL: 5 Vector__XXX
 SG_ control : 32|8@1+ (1,0) [0|0] "" Vector__XXX
 SG_ max charging current low : 24|8@1+ (1,0) [0|0] "" Vector__XXX
 SG_ max charging current high : 16|8@1+ (1,0) [0|0] "" Vector__XXX
 SG_ max charging voltage low : 8|8@1+ (1,0) [0|0] "" Vector__XXX
 SG_ max charging voltage high : 0|8@1+ (1,0) [0|0] "" Vector__XXX

BO_ 2566869221 ID_CHARGER_DATA: 7 Vector__XXX
 SG_ input ac voltage low : 48|8@1+ (1,0) [0|0] "" Vector__XXX
 SG_ input ac voltage high : 40|8@1+ (1,0) [0|0] "" Vector__XXX
 SG_ flags : 32|8@1+ (1,0) [0|0] "" Vector__XXX
 SG_ output current low : 24|8@1+ (1,0) [0|0] "" Vector__XXX
 SG_ output current high : 16|8@1+ (1,0) [0|0] "" Vector__XXX
 SG_ output dc voltage low : 8|8@1+ (1,0) [0|0] "" Vector__XXX
 SG_ output dc voltage high : 0|8@1+ (1,0) [0|0] "" Vector__XXX

BA_DEF_ BO_  "SystemMessageLongSymbol" STRING ;
BA_DEF_DEF_  "SystemMessageLongSymbol" "";
BA_ "SystemMessageLongSymbol" BO_ 214 "ID_BMS_ONBOARD_DETAILED_TEMPERATURES";
VAL_ 235 launch control led 0 "OFF" 1 "ON" 2 "YELLOW" 3 "RED" ;
VAL_ 235 glv led 0 "OFF" 1 "ON" 2 "YELLOW" 3 "RED" ;
VAL_ 235 crit charge led 0 "OFF" 1 "ON" 2 "YELLOW" 3 "RED" ;
VAL_ 235 cockpit brb led 0 "OFF" 1 "ON" 2 "YELLOW" 3 "RED" ;
VAL_ 235 bots led 0 "OFF" 1 "ON" 2 "YELLOW" 3 "RED" ;
VAL_ 235 gen purp led 0 "OFF" 1 "ON" 2 "YELLOW" 3 "RED" ;
VAL_ 235 mechanical brake led 0 "OFF" 1 "ON" 2 "YELLOW" 3 "RED" ;
VAL_ 235 inertia status led 0 "OFF" 1 "ON" 2 "YELLOW" 3 "RED" ;
VAL_ 235 start status led 0 "OFF" 1 "ON" 2 "YELLOW" 3 "RED" ;
VAL_ 235 motor controller error led 0 "OFF" 1 "ON" 2 "YELLOW" 3 "RED" ;
VAL_ 235 mode led 0 "OFF" 1 "ON" 2 "YELLOW" 3 "RED" ;
VAL_ 235 imd led 0 "OFF" 1 "ON" 2 "YELLOW" 3 "RED" ;
VAL_ 235 ams led 0 "OFF" 1 "ON" 2 "YELLOW" 3 "RED" ;
VAL_ 235 dial state 0 "MODE_ONE" 1 "MODE_TWO" 2 "ACCELERATION_LAUNCH_CONTROL" 3 "SKIDPAD" 4 "AUTOCROSS" 5 "ENDURANCE" ;
